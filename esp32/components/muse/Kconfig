## esp32/components/muse/Kconfig
```kconfig
# Copyright (c) Meta Platforms, Inc. and affiliates.
#
# Licensed under the Apache License, Version 2.0 (the "License");
# you may not use this file except in compliance with the License.
# You may obtain a copy of the License at
#
#     http://www.apache.org/licenses/LICENSE-2.0
#
# Unless required by applicable law or agreed to in writing, software
# distributed under the License is distributed on an "AS IS" BASIS,
# WITHOUT WARRANTIES OR CONDITIONS OF ANY KIND, either express or implied.
# See the License for the specific language governing permissions and
# limitations under the License.

menu "Muse"

    choice MUSE_BOARD
        prompt "Board with the full UI"
        default MUSE_BOARD_NONE
        help
            The UI is the voice companion on boards with a screen: an
            animated avatar, push-to-talk chat, settings, and battery
            handling. It runs beside Home Link, which owns Wi-Fi, BLE
            pairing, credentials and OTA. Pick the board it runs on, or none
            for a Link without a display.

        config MUSE_BOARD_NONE
            bool "None (Home Link without a display)"

        config MUSE_BOARD_WAVESHARE_S3_175C
            bool "Waveshare ESP32-S3-Touch-AMOLED-1.75C"
            depends on IDF_TARGET_ESP32S3

        config MUSE_BOARD_WAVESHARE_S3_175
            bool "Waveshare ESP32-S3-Touch-AMOLED-1.75 (not the 1.75C)"
            depends on IDF_TARGET_ESP32S3

        config MUSE_BOARD_AIPI
            bool "AIPI Lite (ESP32-S3, two buttons, no touch)"
            depends on IDF_TARGET_ESP32S3

        config MUSE_BOARD_ESPRESSIF_BOX_3
            bool "Espressif ESP32-S3-BOX-3 (320x240 touch LCD, speaker and microphones)"
            depends on IDF_TARGET_ESP32S3

        config MUSE_BOARD_WAVESHARE_C6_18
            bool "Waveshare ESP32-C6-Touch-AMOLED-1.8"
            depends on IDF_TARGET_ESP32C6

        config MUSE_BOARD_SENSECAP_WATCHER
            bool "Seeed SenseCAP Watcher (ESP32-S3, round touch LCD, wheel)"
            depends on IDF_TARGET_ESP32S3

        config MUSE_BOARD_M5STACK_CARDPUTER_ADV
            bool "M5Stack Cardputer ADV (ESP32-S3, keyboard, no PSRAM)"
            depends on IDF_TARGET_ESP32S3

        config MUSE_BOARD_M5STACK_STICKS3
            bool "M5Stack StickS3 (ESP32-S3, two buttons, no touch)"
            depends on IDF_TARGET_ESP32S3

        config MUSE_BOARD_M5STACK_STICKC_PLUS2
            bool "M5Stack StickC Plus2 (ESP32, two buttons, no touch)"
            depends on IDF_TARGET_ESP32

        config MUSE_BOARD_M5STACK_STOPWATCH
            bool "M5Stack StopWatch (ESP32-S3, round touch AMOLED)"
            depends on IDF_TARGET_ESP32S3

        config MUSE_BOARD_M5STACK_CORES3
            bool "M5Stack CoreS3 (ESP32-S3, 320x240 touch LCD, speaker and microphones)"
            depends on IDF_TARGET_ESP32S3

        config MUSE_BOARD_WAVESHARE_S3_185C
            bool "Waveshare ESP32-S3-Touch-LCD-1.85C (round 360x360 touch LCD, one button)"
            depends on IDF_TARGET_ESP32S3

        config MUSE_BOARD_WAVESHARE_S3_143C
            bool "Waveshare ESP32-S3-Touch-AMOLED-1.43C (round 466x466 touch AMOLED, one button)"
            depends on IDF_TARGET_ESP32S3

        config MUSE_BOARD_WAVESHARE_S3_18
            bool "Waveshare ESP32-S3-Touch-AMOLED-1.8 (368x448 touch AMOLED, two buttons)"
            depends on IDF_TARGET_ESP32S3

        config MUSE_BOARD_M5STACK_CORE2
            bool "M5Stack Core2 v1.0 (ESP32, touch LCD, touch-strip talk)"
            depends on IDF_TARGET_ESP32
        config MUSE_BOARD_FNK0104B
            bool "Freenove FNK0104B (ESP32-S3, 240x320 touch LCD, ES8311 speaker and mic)"
            depends on IDF_TARGET_ESP32S3
        config MUSE_BOARD_GUITION_JC3248W535
            bool "Guition JC3248W535 (ESP32-S3, 3.5\" 320x480 touch LCD, speaker)"
            depends on IDF_TARGET_ESP32S3

        config MUSE_BOARD_WAVESHARE_S3_LCD7
            bool "Waveshare ESP32-S3-Touch-LCD-7 (800x480 touch LCD, no audio)"
            depends on IDF_TARGET_ESP32S3
    endchoice

    config MUSE_ENABLED
        bool
        default y if !MUSE_BOARD_NONE

    # Always defined, unlike the target-dependent board options, so
    # idf_component.yml rules can select each board's managed components.
    config MUSE_BOARD_ID
        string
        default "waveshare_s3_175c" if MUSE_BOARD_WAVESHARE_S3_175C
        default "waveshare_s3_175" if MUSE_BOARD_WAVESHARE_S3_175
        default "aipi" if MUSE_BOARD_AIPI
        default "espressif_box_3" if MUSE_BOARD_ESPRESSIF_BOX_3
        default "waveshare_c6_18" if MUSE_BOARD_WAVESHARE_C6_18
        default "sensecap_watcher" if MUSE_BOARD_SENSECAP_WATCHER
        default "m5stack_sticks3" if MUSE_BOARD_M5STACK_STICKS3
        default "m5stack_stickc_plus2" if MUSE_BOARD_M5STACK_STICKC_PLUS2
        default "m5stack_cardputer_adv" if MUSE_BOARD_M5STACK_CARDPUTER_ADV
        default "m5stack_stopwatch" if MUSE_BOARD_M5STACK_STOPWATCH
        default "m5stack_cores3" if MUSE_BOARD_M5STACK_CORES3
        default "waveshare_s3_185c" if MUSE_BOARD_WAVESHARE_S3_185C
        default "waveshare_s3_143c" if MUSE_BOARD_WAVESHARE_S3_143C
        default "waveshare_s3_18" if MUSE_BOARD_WAVESHARE_S3_18
        default "m5stack_core2" if MUSE_BOARD_M5STACK_CORE2
        default "fnk0104b" if MUSE_BOARD_FNK0104B
        default "guition_jc3248w535" if MUSE_BOARD_GUITION_JC3248W535
        default "waveshare_s3_lcd7" if MUSE_BOARD_WAVESHARE_S3_LCD7
        default "none"

    # The Muse tools' serial port: the console UART behind the board's USB
    # bridge, where the chip's own USB Serial/JTAG isn't wired to a connector
    # (the Watcher's USB-C goes to a CH342) or the chip has none.
    config MUSE_CONSOLE_UART
        bool
        default y if MUSE_BOARD_SENSECAP_WATCHER || MUSE_BOARD_WAVESHARE_S3_LCD7 || !SOC_USB_SERIAL_JTAG_SUPPORTED

    # A board overlay can raise this for a quiet speaker.
    config MUSE_DEFAULT_VOLUME
        int "Speaker volume until one is chosen in settings (percent)"
        range 0 100
        default 70

    config MUSE_WATCHER_CAMERA
        bool "SenseCAP Watcher camera capture and live preview"
        depends on MUSE_BOARD_SENSECAP_WATCHER && SPIRAM
        default n
        help
            Enable the camera.capture Home Link command and the wheel
            double-click camera preview. Camera buffers and tasks consume
            memory and preview decoding shares CPU time with voice and Link.
            Leave disabled to build without camera support.

    config MUSE_CJK_FONT
        bool "Show Chinese and Japanese in captions"
        depends on MUSE_ENABLED
        default n
        help
            Captions fall back to GNU Unifont's 16x16 bitmaps for CJK
            punctuation, kana, the CJK Unified Ideographs and fullwidth
            forms that the ASCII caption font lacks. Small screens, whose
            captions are two lines of 8 px text, show a reply with CJK in it
            one 16 px line at a time. Takes about 850 KB of flash and no RAM.
            Without it those characters show as boxes. Hangul isn't
            included.

    config MUSE_WAKE_WORD
        bool "\"Hey Santa\" wake word starts a talk turn"
        depends on MUSE_HATCH && SPIRAM && IDF_TARGET_ESP32S3
        default n
        help
            While the screen is awake and Muse is idle, the mic listens for
            "hey Santa" (a microWakeWord model, components/muse/wake/, run
            with esp-tflite-micro). Hearing it starts a turn as a talk press
            does: LISTENING shows and the speech goes to Muse. With no
            button to let go of, that turn ends after a short silence once
            speech has started (or with nothing said, quietly drops), and
            the talk button, a click with MUSE_TALK_TOGGLE, still ends it
            too. It doesn't listen while asleep, in the menu, during a
            story, or while Muse is speaking.

    config MUSE_WAKE_WORD_CUTOFF
        int "Wake word cutoff (percent)"
        depends on MUSE_WAKE_WORD
        range 50 99
        default 97
        help
            The mean model probability over 5 runs (150 ms) that counts
            as hearing it: higher misses more, lower false-wakes more.
            97 is hey_santa.json's probability_cutoff.

    config MUSE_FULLSCREEN_ART
        bool "Avatar is a full-screen picture"
        depends on MUSE_ENABLED
        default n
        help
            For a custom components/muse/avatar/muse_pixel.c that draws a
            whole-screen picture rather than a character: the avatar canvas
            becomes the full screen at one screen pixel per pixel, and the
            button hint icons and the status line (Wi-Fi, Bluetooth, battery)
            are not drawn over it on the main screen. Captions, the bottom
            state bar, menus, settings and pop-ups still show.

    config MUSE_TALK_TOGGLE
        bool "Talk button toggles recording"
        depends on MUSE_ENABLED
        default n
        help
            One click of the talk button starts recording and the next
            click stops and sends; releasing the button does nothing.
            A note still stops on its own after 15 s, and the next click
            then starts a new one. A click while Muse is thinking or
            speaking cuts in and starts a new note, as a press does.
            Waking, pairing confirm and menu Select work as with
            push-to-talk. Off: hold to talk.

    config MUSE_MENU_DOUBLE_PRESS
        bool "Menu button: double press opens the menu"
        depends on MUSE_ENABLED
        default n
        help
            For boards without touch, where the aux button opens the menu.
            On the main screen a single press does nothing (it still wakes
            a sleeping screen), a double press opens the menu and four
            presses toggle phone setup (Bluetooth pairing). Presses count
            as one run while each comes within 350 ms of the last, and the
            run acts once they stop. In the menu each press steps down it
            at once, as before. Off: one press opens the menu.

    menu "North Pole Santa Communicator extras"
        depends on MUSE_FULLSCREEN_ART
        comment "Need the NPSC avatar (avatar/npsc_screens.h, npsc_jingle.h)"

    config MUSE_NPSC_COUNTDOWN
        bool "Sleeps-to-Christmas count under the idle art"
        default n
        help
            Once the clock is set over the network (SNTP, after Wi-Fi joins;
            time zone America/Los_Angeles), the idle screen switches to a
            layout with "<N> sleeps" under the tree, counting days to
            December 25 (next year's after it). On Christmas Day it reads
            "Merry Christmas!". Until the clock is set the approved idle art
            shows unchanged.

    config MUSE_NPSC_WAKE_SPLASH
        bool "Sleeps countdown splash on waking"
        default n
        help
            For 3 s after the screen wakes (clock set, not Christmas
            Day) a full-screen countdown splash shows. Its art is a
            placeholder: screens/wake.png from design/make_feature_screens.py
            (scr_wake), number box drawn in avatar/muse_pixel.c (LAYOUT_WAKE).

    config MUSE_NPSC_STORY
        bool "Story time: three presses of MENU"
        depends on MUSE_HATCH && MUSE_MENU_DOUBLE_PRESS
        default n
        help
            Three presses of MENU on the main screen tell one of ten short
            (about 45 second) Christmas bedtime stories, word for word, in the
            ElevenLabs voice (MUSE_ELEVENLABS_API_KEY) while the STORY TIME
            screen shows; Muse isn't asked, but Wi-Fi is needed. Each story
            plays once, in random order, before any repeats. The kid's name
            (MUSE_NPSC_PARENT) is said in each, or "my friend" with none set.
            A press of either button stops it. The stories are in
            avatar/npsc_stories.h, built by design/make_stories.py; sources
            and licenses are in design/CREDITS.md.

    config MUSE_NPSC_ELF
        bool "Elf on Duty at bedtime"
        default n
        help
            At bedtime (menu: Bedtime, default 8:00 pm; clock must be set)
            the screen wakes to a dim sleepy-Santa page with the backlight
            lowered, and Santa says a short goodnight through Muse (or, when
            Muse can't be reached, the jingle plays if that is enabled).
            Any press goes back to normal.

    config MUSE_NPSC_TRACKER
        bool "Christmas Eve sleigh tracker (simulated)"
        default n
        help
            On December 24 from 5 pm local time the idle screen shows
            "Santa's sleigh is over... <place>", from a made-up route in
            muse_npsc.c keyed to the clock and arriving around midnight. No
            network data is used.

    config MUSE_NPSC_JINGLE
        bool "Jingle: five presses of MENU"
        depends on MUSE_MENU_DOUBLE_PRESS
        default n
        help
            Five presses of MENU on the main screen play a 3.3 s sleigh-bell
            recording stored in flash ("Sleigh bells.wav" by The Midnite
            Wolf, Wikimedia Commons, CC0) and show the JINGLE! screen.

    config MUSE_NPSC_WAKE_RECORD
        bool "Hey Santa recording: four presses of MENU"
        depends on MUSE_HATCH && MUSE_MENU_DOUBLE_PRESS && MUSE_WAKE_WORD
        default y
        help
            Four presses of MENU on the main screen start a five-round
            "Hey Santa" recording session. Santa (the ElevenLabs voice,
            same as story time; needs Wi-Fi) says "Let's do a test of
            five. I'll cue you each time.", then each round plays a
            short beep and records the child saying "hey santa". Rounds
            2-5 are cued with "Again!". A round is kept if speech starts
            within 5 s, and ends 1 s after the last word, or at 3 s.
            Silence for 5 s skips the round. Clips stay in PSRAM until
            reboot (16 kHz 16-bit mono). The console command "clips"
            writes them as WAV over the USB serial port. A press of
            either button stops the session. The wake word does not
            start a conversation while this runs. These are children's
            voices: do not upload them or put them in a public repo.

    config MUSE_NPSC_PARENT
        bool "Kid's name: menu entry and wake greeting"
        default n
        help
            Adds "Kid's name" to the menu: an on-device letter picker (MENU
            next letter, COMMUNICATE picks; Space, Delete and Done at the
            end of the letters). The name is kept in flash (NVS) and can also
            be set with the Bluetooth/console command kid.name=<name>. On
            waking, "Ho ho ho, <name>!" shows briefly, and stories and
            goodnights ask Santa to use the name.

    config MUSE_NPSC_KID_NAME_DEFAULT
        string "Kid's name until one is picked"
        depends on MUSE_NPSC_PARENT
        default ""
        help
            Used until a name is set from the menu or with kid.name (those
            are kept in NVS and win, even when set empty). Up to 24
            characters; two names read naturally, e.g. "Alex and Sam".

    config MUSE_NPSC_BOOT_SHOW_MS
        int "How long the power-on screen shows (ms)"
        range 0 10000
        default 1400
        help
            At power-on the picture shows with "WAKING UP..." while the
            boot finishes; this is how long, in milliseconds, before the
            voice pipeline, Wi-Fi and the rest start and the screen goes to
            idle (with the wake greeting and splash). Upstream waits 1400.
            Longer holds also put off Wi-Fi by the difference.

    endmenu

    config MUSE_NPSC
        bool
        default y if MUSE_NPSC_COUNTDOWN || MUSE_NPSC_WAKE_SPLASH || MUSE_NPSC_STORY || MUSE_NPSC_ELF || MUSE_NPSC_TRACKER || MUSE_NPSC_JINGLE || MUSE_NPSC_WAKE_RECORD || MUSE_NPSC_PARENT

    config MUSE_NPSC_CLOCK
        bool
        default y if MUSE_NPSC_COUNTDOWN || MUSE_NPSC_WAKE_SPLASH || MUSE_NPSC_ELF || MUSE_NPSC_TRACKER

    config MUSE_NPSC_SPOKEN
        bool
        default y if MUSE_HATCH && (MUSE_NPSC_STORY || MUSE_NPSC_ELF)

    config MUSE_JC3248W535_MIC_GPIO
        int "JC3248W535: GPIO for an external I2S mic's data (SD) line"
        depends on MUSE_BOARD_GUITION_JC3248W535
        range -1 48
        default -1
        help
            The board has a speaker amp but no microphone. Wire an I2S MEMS
            mic such as an INMP441 to the speaker's clocks (SCK to GPIO42, WS
            to GPIO2), L/R to GND, power to 3.3 V, and its SD line to a free
            GPIO, and set that GPIO here. -1 leaves push-to-talk recording
            silence.

    config MUSE_HATCH
        bool "Muse's own voice session"
        depends on MUSE_ENABLED
        default y if SPIRAM
        default n
        help
            Push-to-talk turns go over a voice session of Muse's own, to the
            VM Home Link is paired with or one set up on the device with a
            device token. Replies are text, shown as captions; start_tts in
            muse_chat_session.cpp is where a TTS API of your own can speak
            them. Needs PSRAM. Without it, voice notes go over Home Link's own
            session to its paired VM and replies are shown as text.

    config MUSE_ELEVENLABS_API_KEY
        string "ElevenLabs API key for spoken replies"
        depends on MUSE_HATCH
        default ""
        help
            With a key, start_tts sends each reply's text to ElevenLabs'
            streaming text-to-speech and plays the MP3 it returns, captions
            following the speech. The key needs the Text to Speech
            permission. Empty: replies stay text. Like the SDK token, the key
            ships inside the firmware: never commit a generated sdkconfig.

    config MUSE_ELEVENLABS_VOICE_ID
        string "ElevenLabs voice ID"
        depends on MUSE_HATCH
        default "EXAVITQu4vr4xnSDxMaL"
        help
            Any voice in the account's library. The default is the premade
            "Sarah".

    config MUSE_ELEVENLABS_MODEL
        string "ElevenLabs model"
        depends on MUSE_HATCH
        default "eleven_flash_v2_5"
        help
            eleven_flash_v2_5 answers fastest and speaks 32 languages;
            eleven_multilingual_v2 sounds richer but starts later.

    config MUSE_ELEVENLABS_LANGUAGE
        string "ElevenLabs speech language (ISO 639-1)"
        depends on MUSE_HATCH
        default "en"
        help
            Sent as language_code so the multilingual flash/turbo models
            speak (and read numbers and dates) in this language instead of
            guessing it from the text and the voice. Empty: not sent.
            eleven_multilingual_v2 doesn't take it and ignores it.

endmenu
```
